## drivers/miaochuang8lou/Kconfig
```kconfig
#
# miaochuang8lou device configuration
#


config MC8L_SUPPORT
	bool "miaochuang8lou driver support"
	default n
	---help---
	  Enable support for webcams and video grabbers.

	  Say Y when you have a webcam or a video capture grabber board.

	  
	  
source "drivers/miaochuang8lou/mc_gpio/Kconfig"
source "drivers/miaochuang8lou/mc_spi/Kconfig"
source "drivers/miaochuang8lou/mc_pwm/Kconfig"
source "drivers/miaochuang8lou/mc_i2c/Kconfig"
```

## drivers/miaochuang8lou/mc_gpio/Kconfig
```kconfig
#
# miaochuang8lou device configuration
#


config MC_GPIO_SUPPORT
	bool "mc8l gpio support"
	default n
	---help---
	  Enable support for webcams and video grabbers.

	  Say Y when you have a webcam or a video capture grabber board.
```

## drivers/miaochuang8lou/mc_i2c/Kconfig
```kconfig
#
# miaochuang8lou device configuration
#


config MC_I2C_SUPPORT
	bool "mc8l i2c support"
	default n
	---help---
	  Enable support for webcams and video grabbers.

	  Say Y when you have a webcam or a video capture grabber board.
```

## drivers/miaochuang8lou/mc_pwm/Kconfig
```kconfig
#
# miaochuang8lou device configuration
#


config MC_PWM_SUPPORT
	tristate "mc8l pwm support"
	---help---
	  Enable support for webcams and video grabbers.

	  Say Y when you have a webcam or a video capture grabber board.
```

## drivers/miaochuang8lou/mc_spi/Kconfig
```kconfig
#
# miaochuang8lou device configuration
#


config MC_SPI_SUPPORT
	bool "mc8l spi support"
	default n
	---help---
	  Enable support for webcams and video grabbers.

	  Say Y when you have a webcam or a video capture grabber board.
```
